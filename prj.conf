## CMakeLists.txt
```
# Copyright (c) 2025 Conexio Technologies, Inc

cmake_minimum_required(VERSION 3.20.0)

find_package(Zephyr REQUIRED HINTS $ENV{ZEPHYR_BASE})

project(solaris)

target_sources(app PRIVATE src/main.c)
target_sources(app PRIVATE src/app_rpc.c)
target_sources(app PRIVATE src/app_settings.c)
target_sources(app PRIVATE src/app_state.c)
target_sources(app PRIVATE src/app_sensors.c)
target_sources(app PRIVATE src/fuel_gauge.c)
target_sources(app PRIVATE src/location_tracking.c)
target_sources_ifdef(CONFIG_SOC_SERIES_NRF91X app PRIVATE src/cellular_nrf91.c)
```

## Kconfig
```
# Copyright (c) 2025 Conexio Technologies, Inc
# Copyright (c) 2022-2023 Golioth, Inc.
# SPDX-License-Identifier: Apache-2.0

mainmenu "Golioth application options"

if DNS_RESOLVER

config DNS_SERVER_IP_ADDRESSES
	default y

config DNS_SERVER1
	default "1.1.1.1"

endif # DNS_RESOLVER

config SENSOR_SAMPLE_INTERVAL_SECONDS
	int "Sensor sampling interval (seconds)"
	default 60
	help
	  Sets the time to wait between each sensor sample.

config ACCELEROMETER_SAMPLE_INTERVAL_SECONDS
	int "LIS2DH sampling interval (seconds)"
	default 60
	help
	  Sets the time to wait between each vibration sample.

config LED_INDICATION_ENABLED
	bool "Enable indicator LED"
	default n

config SHT3XD
	bool "SHT3x Temperature and Humidity Sensor"
	default n
	help
	  Enable driver for SHT3x temperature and humidity sensors.

configdefault GOLIOTH_LOCATION_CELLULAR
    default y if SOC_SERIES_NRF91X

config LOCATION_TRACKING_THREAD_STACK_SIZE
	int "Location tracking Thread Stack Size (bytes)"
	default 2048
	help
	  Sets the stack size (in bytes) for the application thread of the
	  location sampling.

menuconfig LOCATION_TRACKING
	bool "Location tracking service"
	default y
	help
	  Uses GNSS or LTE, information to determine and report device
	  location.

if LOCATION_TRACKING

config LOCATION_TRACKING_SAMPLE_INTERVAL_SECONDS
	int "Location sampling interval (seconds)"
	default 3600
	help
	  Sets the location sampling interval in seconds.

config LOCATION_TRACKING_CELLULAR
	bool "Use cellular method for location tracking"
	default y
	depends on LOCATION_METHOD_CELLULAR
	help
	  Disable all location tracking methods to completely disable location tracking.

endif

source "Kconfig.zephyr"
```

## prj.conf
```kconfig
# Copyright (c) 2025 Conexio Technologies, Inc
# Copyright (c) 2022-2023 Golioth, Inc.
# SPDX-License-Identifier: Apache-2.0

# Enable Golioth Firmware SDK
CONFIG_GOLIOTH_FIRMWARE_SDK=y

# Golioth services used in this app
CONFIG_GOLIOTH_FW_UPDATE=y
CONFIG_GOLIOTH_LIGHTDB_STATE=y
CONFIG_GOLIOTH_RPC=y
CONFIG_GOLIOTH_SETTINGS=y
CONFIG_GOLIOTH_STREAM=y

# Send logs to Golioth backend
CONFIG_LOG_BACKEND_GOLIOTH=n

# Enable common sample library
CONFIG_GOLIOTH_SAMPLE_COMMON=y

# Configure Golioth SDK dependencies
CONFIG_ZVFS_EVENTFD_MAX=14
CONFIG_ZVFS_OPEN_MAX=23
CONFIG_LOG_PROCESS_THREAD_STACK_SIZE=1536
CONFIG_MBEDTLS_ENABLE_HEAP=y
CONFIG_MBEDTLS_HEAP_SIZE=10240
CONFIG_MBEDTLS_SSL_IN_CONTENT_LEN=2048
CONFIG_MBEDTLS_SSL_OUT_CONTENT_LEN=2048
CONFIG_NETWORKING=y
CONFIG_NET_IPV4=y

# Application
CONFIG_MAIN_STACK_SIZE=2048
CONFIG_SYSTEM_WORKQUEUE_STACK_SIZE=2048
CONFIG_NET_LOG=y

# Flash memory (etc.) for firmware upgrade
CONFIG_FLASH=y
CONFIG_FLASH_MAP=y
CONFIG_NVS=y
CONFIG_STREAM_FLASH=y
CONFIG_IMG_MANAGER=y
CONFIG_IMG_ERASE_PROGRESSIVELY=y
CONFIG_REBOOT=y

# The rest of the runtime credentials config
CONFIG_SETTINGS=y
CONFIG_SETTINGS_RUNTIME=y
CONFIG_GOLIOTH_SAMPLE_SETTINGS=y
CONFIG_GOLIOTH_SAMPLE_SETTINGS_AUTOLOAD=y
CONFIG_GOLIOTH_SAMPLE_SETTINGS_SHELL=y

# Misc.
CONFIG_JSON_LIBRARY=y
CONFIG_NETWORK_INFO=y
# Longer response length needed for network info
CONFIG_GOLIOTH_RPC_MAX_RESPONSE_LEN=512

# Enable I2C
CONFIG_I2C=y

# Enable sensors
CONFIG_SENSOR=y

# newlibc for printing floats
CONFIG_NEWLIB_LIBC=y
CONFIG_NEWLIB_LIBC_FLOAT_PRINTF=y
CONFIG_CBPRINTF_FP_SUPPORT=y

# Enable nPM1300 fuel gauge
CONFIG_REGULATOR=y
CONFIG_NRF_FUEL_GAUGE=y
CONFIG_REQUIRES_FLOAT_PRINTF=y

# Enable Connection LED
CONFIG_LED_INDICATION_ENABLED=n

# Date-Time library
CONFIG_DATE_TIME=y

# LTE link control
CONFIG_LTE_LINK_CONTROL=y

# LTE parameters
## Power saving timers.
# Enable power savings mode
CONFIG_LTE_PSM_REQ=y
### 1 hour PSM.
CONFIG_LTE_PSM_REQ_RPTAU="00100001"
### 0 seconds active time.
CONFIG_LTE_PSM_REQ_RAT="00000000"

## RAI
CONFIG_LTE_RAI_REQ=y

# Enable required LTE link control modules
CONFIG_LTE_LC_PSM_MODULE=y
CONFIG_LTE_LC_RAI_MODULE=y

# Disable Golioth keepalive
CONFIG_GOLIOTH_COAP_KEEPALIVE_INTERVAL_S=0
CONFIG_GOLIOTH_COAP_CLIENT_RX_TIMEOUT_SEC=1200
CONFIG_GOLIOTH_USE_CONNECTION_ID=y

# How often to sample and send sensor data
CONFIG_SENSOR_SAMPLE_INTERVAL_SECONDS=3600

# How often to fetch cellular location data
CONFIG_GOLIOTH_LOCATION=y
CONFIG_LOCATION_TRACKING=y
CONFIG_LOCATION_TRACKING_SAMPLE_INTERVAL_SECONDS=7200
```

## overlay_low_power.conf
```kconfig
# Copyright (c) 2025 Conexio Technologies, Inc.
# SPDX-License-Identifier: Apache-2.0

# Disable serial logging
CONFIG_SERIAL=n
CONFIG_LOG=n
CONFIG_UART_CONSOLE=n
CONFIG_NET_SHELL=n
```

## boards/conexio_stratus_pro_nrf9161_ns.conf
```kconfig
# Copyright (c) 2025 Conexio Technologies, Inc.
# SPDX-License-Identifier: Apache-2.0

# LED 
CONFIG_GPIO=y

# General config
CONFIG_HEAP_MEM_POOL_SIZE=4096
CONFIG_NEWLIB_LIBC=y

# Networking
CONFIG_NET_SOCKETS_OFFLOAD=y
CONFIG_NET_IPV6=y
CONFIG_NET_IPV6_NBR_CACHE=n
CONFIG_NET_IPV6_MLD=n

# Increase native TLS socket implementation, so that it is chosen instead of
# offloaded nRF91 sockets
CONFIG_NET_SOCKETS_TLS_PRIORITY=35

# Modem library
CONFIG_NRF_MODEM_LIB=y

# LTE connectivity with network connection manager
CONFIG_NRF_MODEM_LIB_NET_IF=y
CONFIG_NRF_MODEM_LIB_NET_IF_AUTO_START=y
CONFIG_NRF_MODEM_LIB_NET_IF_AUTO_CONNECT=y
CONFIG_NET_CONNECTION_MANAGER=y
CONFIG_NET_CONNECTION_MANAGER_MONITOR_STACK_SIZE=1024

# Add Logs for LTE Link Handler
CONFIG_GOLIOTH_SAMPLE_NRF91_LTE_MONITOR=n

# Increased sysworkq size, due to LTE connectivity
CONFIG_SYSTEM_WORKQUEUE_STACK_SIZE=2048

# Disable options y-selected by NCS for no good reason
CONFIG_MBEDTLS_KEY_EXCHANGE_DHE_PSK_ENABLED=n
CONFIG_MBEDTLS_KEY_EXCHANGE_DHE_RSA_ENABLED=n

# MbedTLS configuration to support p-384 curve. These options
# enable using the MbedTLS built-in support for operations not
# supported by the default nRF Oberon crypto backend
CONFIG_NORDIC_SECURITY_BACKEND=n
CONFIG_MBEDTLS_LEGACY_CRYPTO_C=y

# Add Network Info Support
CONFIG_MODEM_INFO=y

# For location using LTE
CONFIG_LTE_LC_NEIGHBOR_CELL_MEAS_MODULE=y

# Generate MCUboot compatible images
CONFIG_BOOTLOADER_MCUBOOT=y
```

## boards/conexio_stratus_pro_nrf9151_ns.overlay
```dts
/*
 * Copyright (c) 2025 Conexio Technologies, Inc.
 *
 * SPDX-License-Identifier: Apache-2.0
 */

&uart0 {
	status = "okay";
	current-speed = <115200>;
	/delete-property/ rx-pin;
};
```

## src/main.c
```c
/*
 * Copyright (c) 2025 Conexio Technologies, Inc.
 * Copyright (c) 2022-2023 Golioth, Inc.
 * Author: Rajeev Piyare <rajeev@conexiotech.com>
 *
 * SPDX-License-Identifier: Apache-2.0
 */

#include <zephyr/logging/log.h>
LOG_MODULE_REGISTER(solaris, LOG_LEVEL_DBG);

#include <app_version.h>
#include "app_rpc.h"
#include "app_settings.h"
#include "app_state.h"
#include "app_sensors.h"
#include <golioth/client.h>
#include <golioth/fw_update.h>
#include <samples/common/net_connect.h>
#include <samples/common/sample_credentials.h>
#include <zephyr/kernel.h>
#include <zephyr/drivers/gpio.h>
#include <modem/lte_lc.h>
#include <helpers/nrfx_reset_reason.h>
#include "location_tracking.h"

#ifdef CONFIG_NRF_FUEL_GAUGE
#include "fuel_gauge.h"
#endif

#ifdef CONFIG_MODEM_INFO
#include <modem/modem_info.h>
#endif

/* Current firmware version; update in VERSION */
static const char *_current_version =
	STRINGIFY(APP_VERSION_MAJOR) "." STRINGIFY(APP_VERSION_MINOR) "." STRINGIFY(APP_PATCHLEVEL);

struct golioth_client *client;

K_SEM_DEFINE(connected, 0, 1);

static k_tid_t _system_thread = 0;

#if defined(CONFIG_LOCATION_TRACKING)
/* Start the cellular location thread with a delay of 30s */
K_THREAD_DEFINE(cell_location_thread, CONFIG_LOCATION_TRACKING_THREAD_STACK_SIZE, location_tracking_thread_fn,
		NULL, NULL, NULL, 0, 0, 30000);
#endif

static const struct gpio_dt_spec stratus_led = GPIO_DT_SPEC_GET(DT_ALIAS(led0), gpios);

/* forward declarations */
#if CONFIG_LED_INDICATION_ENABLED
void device_connection_led_set(uint8_t state);
#endif

void wake_system_thread(void)
{
	k_wakeup(_system_thread);
}

static void on_client_event(struct golioth_client *client,
							enum golioth_client_event event,
							void *arg)
{
	bool is_connected = (event == GOLIOTH_CLIENT_EVENT_CONNECTED);

	if (is_connected)
	{
		k_sem_give(&connected);

		#if CONFIG_LED_INDICATION_ENABLED
			device_connection_led_set(1);
		#endif
	}
	LOG_INF("Golioth client %s", is_connected ? "connected" : "disconnected");
}

static void start_golioth_client(void)
{
	/* Get the client configuration from auto-loaded settings */
	const struct golioth_client_config *client_config = golioth_sample_credentials_get();

	/* Create and start a Golioth Client */
	client = golioth_client_create(client_config);

	/* Register Golioth on_connect callback */
	golioth_client_register_event_callback(client, on_client_event, NULL);

	/* Initialize DFU components */
	// golioth_fw_update_init(client, _current_version);

	/*** Call Golioth APIs for other services in dedicated app files ***/

	/* Observe State service data */
	app_state_observe(client);

	/* Set Golioth Client for streaming sensor data */
	app_sensors_set_client(client);

	/* Register Settings service */
	app_settings_register(client);

	/* Register RPC service */
	//app_rpc_register(client);
}

static void lte_handler(const struct lte_lc_evt *const evt)
{
	switch (evt->type)
	{
		case LTE_LC_EVT_NW_REG_STATUS:
			switch (evt->nw_reg_status)
			{
			case LTE_LC_NW_REG_REGISTERED_ROAMING:
			case LTE_LC_NW_REG_REGISTERED_HOME:
				if (!client)
				{
					/* Create and start a Golioth Client */
					start_golioth_client();
				}
				break;
			}
			break;
	#if CONFIG_LTE_PSM_REQ
		case LTE_LC_EVT_PSM_UPDATE:
			LOG_INF("PSM parameter update: TAU: %d s, Active time: %d s\n",
					evt->psm_cfg.tau, evt->psm_cfg.active_time);
			break;
		case LTE_LC_EVT_CELL_UPDATE:
			LOG_INF("LTE cell changed: Cell ID: %d, Tracking area: %d\n",
					evt->cell.id, evt->cell.tac);
			break;
	#endif
		default:
			break;
	}
}

#if CONFIG_LTE_PSM_REQ
static int configure_lte_low_power(void)
{
	int err;

	if (IS_ENABLED(CONFIG_LTE_PSM_REQ))
	{
		/** Power Saving Mode */
		err = lte_lc_psm_req(true);

		if (err)
		{
			LOG_ERR("lte_lc_psm_req, error: %d", err);
		}
	}

	return err;
}
#endif

#ifdef CONFIG_MODEM_INFO
static void log_modem_firmware_version(void)
{
	int err;
	char sbuf[128];

	/* Initialize modem info */
	err = modem_info_init();
	if (err)
	{
		LOG_ERR("Failed to initialize modem info: %d", err);
	}

	/* Log modem firmware version */
	modem_info_string_get(MODEM_INFO_FW_VERSION, sbuf, sizeof(sbuf));
	LOG_INF("Modem firmware version: %s", sbuf);
}
#endif

#if CONFIG_LED_INDICATION_ENABLED
/* Set (unset) LED indicators for active Golioth connection */
void device_connection_led_set(uint8_t state)
{
	/* Blink LED once connected */
	gpio_pin_set_dt(&stratus_led, 1);
	k_msleep(2000);
	gpio_pin_set_dt(&stratus_led, 0);
}
#endif

static void reset_reason_str_get(char *str, uint32_t reason)
{
	size_t len;

	*str = '\0';

	if (reason & NRFX_RESET_REASON_RESETPIN_MASK) {
		(void)strcat(str, "PIN reset | ");
	}
	if (reason & NRFX_RESET_REASON_DOG_MASK) {
		(void)strcat(str, "watchdog | ");
	}
	if (reason & NRFX_RESET_REASON_OFF_MASK) {
		(void)strcat(str, "wakeup from power-off | ");
	}
	if (reason & NRFX_RESET_REASON_DIF_MASK) {
		(void)strcat(str, "debug interface wakeup | ");
	}
	if (reason & NRFX_RESET_REASON_SREQ_MASK) {
		(void)strcat(str, "software | ");
	}
	if (reason & NRFX_RESET_REASON_LOCKUP_MASK) {
		(void)strcat(str, "CPU lockup | ");
	}
	if (reason & NRFX_RESET_REASON_CTRLAP_MASK) {
		(void)strcat(str, "control access port | ");
	}

	len = strlen(str);
	if (len == 0) {
		(void)strcpy(str, "power-on reset");
	} else {
		str[len - 3] = '\0';
	}
}

static void print_reset_reason(void)
{
	uint32_t reset_reason;
	char reset_reason_str[128];
	reset_reason = nrfx_reset_reason_get();

	reset_reason_str_get(reset_reason_str, reset_reason);
	LOG_INF("Reset reason: %s (0x%x)", reset_reason_str, reset_reason);
}

int main(void)
{
	int err;

	LOG_DBG("Starting sample on %s\n", CONFIG_BOARD);
	LOG_INF("Firmware version: %s", _current_version);
	IF_ENABLED(CONFIG_MODEM_INFO, (log_modem_firmware_version();));
	print_reset_reason();

	/* Get system thread id so loop delay change event can wake main */
	_system_thread = k_current_get();

	/* Initialize LED */
	err = gpio_pin_configure_dt(&stratus_led, GPIO_OUTPUT_INACTIVE);
	if (err)
	{
		LOG_ERR("Unable to configure LED");
	}

#if defined(CONFIG_NRF_FUEL_GAUGE)
	bool fuel_gauge_initialized = npm1300_fuel_gauge_init();

	if (!fuel_gauge_initialized)
	{
		LOG_ERR("Fuel gauge init, error: %d", fuel_gauge_initialized);
		return 0;
	}
#endif

	/* Start LTE asynchronously if the nRF91xx is used.
	 * Golioth Client will start automatically when LTE connects
	 */

	LOG_INF("Connecting to LTE, this may take some time...");
	err = lte_lc_connect_async(lte_handler);
	if (err)
	{
		LOG_ERR("Failed to connect to LTE network, error: %d", err);
		return -1;
	}

#if CONFIG_LTE_PSM_REQ
	err = configure_lte_low_power();
	if (err)
	{
		printk("Unable to set low power configuration, error: %d", err);
	}
#endif

	/* Block until connected to Golioth */
	k_sem_take(&connected, K_FOREVER);

	report_startup();

	while (true)
	{
		/* Check LTE connection and if Golioth client is connected */
		if (!golioth_client_is_connected(client))
		{
			LOG_DBG("LTE connection lost, reconnecting...");
			lte_lc_connect_async(lte_handler);
			k_sem_take(&connected, K_FOREVER);
		}

		/* Read sensor data and send it */
		app_sensors_read_and_stream();

		/* Sleep before the next cycle */
		k_sleep(K_SECONDS(get_loop_delay_s()));
	}
}
```

## src/app_sensors.c
```c
/*
 * Copyright (c) 2025 Conexio Technologies, Inc
 * Author: Rajeev Piyare <rajeev@conexiotech.com>
 *
 * SPDX-License-Identifier: Apache-2.0
 */

#include <zephyr/logging/log.h>
LOG_MODULE_REGISTER(app_sensors, LOG_LEVEL_DBG);

#include <golioth/client.h>
#include <golioth/stream.h>
#include <zcbor_encode.h>
#include <zephyr/drivers/gpio.h>
#include <zephyr/kernel.h>
#include <zephyr/device.h>
#include <date_time.h>
#include <stdio.h>
#include <zephyr/drivers/sensor.h>
#include "app_sensors.h"
#include "fuel_gauge.h"
#include <helpers/nrfx_reset_reason.h>
#include <modem/modem_info.h>

#define NUM_SENSOR_KEY_VALUE_PAIRS   2
#define MODEM_MAP_ENTRIES            4
#define BATTERY_MAP_ENTRIES          5

#define JSON_FMT "{\"rst_reason\":%d}"

static struct golioth_client *client;

static uint32_t tx_success_counter = 0;
static uint32_t tx_failure_counter = 0;

/* Callback for LightDB Stream */
void async_error_handler(struct golioth_client *client, enum golioth_status status,
						 const struct golioth_coap_rsp_code *coap_rsp_code, const char *path,
						 void *arg)
{
	if (status != GOLIOTH_OK)
	{
		LOG_ERR("Async task failed: %d", status);
		return;
	}
}

uint32_t app_sensors_get_tx_success_count(void)
{
	return tx_success_counter;
}

uint32_t app_sensors_get_tx_failure_count(void)
{
	return tx_failure_counter;
}

static enum golioth_status read_modem_data(zcbor_state_t *zse)
{
	bool ok;
	int err;
	int modem_voltage;
	int modem_temp;

	err = modem_info_get_batt_voltage(&modem_voltage);
	if (err) {
		LOG_ERR("Modem voltage read failed, err: %d\n", err);
		return GOLIOTH_ERR_FAIL;
	}
	LOG_INF("Modem voltage: %d mV", modem_voltage);

	err = modem_info_get_temperature(&modem_temp);
	if (err) {
		LOG_ERR("Modem Temp read failed, err: %d\n", err);
		return GOLIOTH_ERR_FAIL;
	}
	LOG_INF("Modem Temp: %d degC\n", modem_temp);

	ok = zcbor_tstr_put_lit(zse, "modem") && zcbor_map_start_encode(zse, MODEM_MAP_ENTRIES);
	if (!ok) {
		LOG_ERR("ZCBOR unable to open modem map");
		return GOLIOTH_ERR_QUEUE_FULL;
	}

	ok = zcbor_tstr_put_lit(zse, "vbat") &&
		 zcbor_int32_put(zse, modem_voltage) &&
		 zcbor_tstr_put_lit(zse, "temp") &&
		 zcbor_int32_put(zse, modem_temp) &&
		 zcbor_tstr_put_lit(zse, "success") &&
		 zcbor_int32_put(zse, app_sensors_get_tx_success_count()) &&
		 zcbor_tstr_put_lit(zse, "fail") &&
		 zcbor_int32_put(zse, app_sensors_get_tx_failure_count());

	if (!ok) {
		LOG_ERR("ZCBOR failed to encode modem data");
		return GOLIOTH_ERR_QUEUE_FULL;
	}

	ok = zcbor_map_end_encode(zse, MODEM_MAP_ENTRIES);
	if (!ok) {
		LOG_ERR("ZCBOR failed to close modem map");
		return GOLIOTH_ERR_QUEUE_FULL;
	}

	return GOLIOTH_OK;
}

static enum golioth_status read_battery_data(zcbor_state_t *zse)
{
	bool ok;
	struct battery_data batt_data;
	get_battery_data(&batt_data);

	struct sensor_value voltage;
	struct sensor_value current;
	struct sensor_value soc;
	struct sensor_value tte;
	struct sensor_value ttf;

	sensor_value_from_double(&voltage, batt_data.voltage);
	sensor_value_from_double(&current, batt_data.current);
	sensor_value_from_double(&soc, batt_data.soc);
	sensor_value_from_double(&tte, batt_data.tte);
	sensor_value_from_double(&ttf, batt_data.ttf);

	ok = zcbor_tstr_put_lit(zse, "battery") && zcbor_map_start_encode(zse, BATTERY_MAP_ENTRIES);
	if (!ok)
	{
		LOG_ERR("ZCBOR unable to open battery map");
		return GOLIOTH_ERR_QUEUE_FULL;
	}

	ok = zcbor_tstr_put_lit(zse, "V") &&
		 zcbor_float64_put(zse, sensor_value_to_double(&voltage)) &&
		 zcbor_tstr_put_lit(zse, "I") &&
		 zcbor_float64_put(zse, sensor_value_to_double(&current)) &&
		 zcbor_tstr_put_lit(zse, "SoC") &&
		 zcbor_float64_put(zse, sensor_value_to_double(&soc)) &&
		 zcbor_tstr_put_lit(zse, "tte") &&
		 zcbor_float64_put(zse, sensor_value_to_double(&tte)) &&
		 zcbor_tstr_put_lit(zse, "ttf") &&
		 zcbor_float64_put(zse, sensor_value_to_double(&ttf));

	if (!ok)
	{
		LOG_ERR("ZCBOR failed to encode battery data");
		return GOLIOTH_ERR_QUEUE_FULL;
	}

	ok = zcbor_map_end_encode(zse, BATTERY_MAP_ENTRIES);
	if (!ok)
	{
		LOG_ERR("ZCBOR failed to close battery map");
		return GOLIOTH_ERR_QUEUE_FULL;
	}

	return GOLIOTH_OK;
}

/* This will be called by the main() loop */
/* Do all of your work here! */
void app_sensors_read_and_stream(void)
{
	int err;
	bool ok;
	enum golioth_status status;
	char cbor_buf[256];

	ZCBOR_STATE_E(zse, NUM_SENSOR_KEY_VALUE_PAIRS, cbor_buf, sizeof(cbor_buf), 1);

	ok = zcbor_map_start_encode(zse, NUM_SENSOR_KEY_VALUE_PAIRS);

	if (!ok)
	{
		LOG_ERR("ZCBOR failed to open map");
		return;
	}

	status = read_modem_data(zse);
	if (status == GOLIOTH_ERR_QUEUE_FULL)
	{
		return;
	}

	status = read_battery_data(zse);
	if (status == GOLIOTH_ERR_QUEUE_FULL)
	{
		return;
	}

	ok = zcbor_map_end_encode(zse, NUM_SENSOR_KEY_VALUE_PAIRS);
	if (!ok)
	{
		LOG_ERR("ZCBOR failed to close map");
	}

	size_t cbor_size = zse->payload - (const uint8_t *)cbor_buf;

	/* Only stream sensor data if connected */
	if (golioth_client_is_connected(client))
	{
		/* Send to LightDB Stream on "sensor" endpoint */
		err = golioth_stream_set_async(client, "sensor", GOLIOTH_CONTENT_TYPE_CBOR, cbor_buf,
									   cbor_size, async_error_handler, NULL);
		if (err)
		{   
			tx_failure_counter++;
			LOG_ERR("Failed to send sensor data to Golioth: %d", err);
		}
		else 
		{
			tx_success_counter++;
		}
	}
	else
	{
		LOG_DBG("No connection available, skipping sending data to Golioth");
	}
}

void app_sensors_set_client(struct golioth_client *sensors_client)
{
	client = sensors_client;
}

#define DEVICE_DATA_ENDP "device/state"

int report_startup(void)
{
	int err;
	char json_buf[128];
	uint32_t reset_reason;
	
	reset_reason = nrfx_reset_reason_get();
	snprintk(json_buf, sizeof(json_buf), JSON_FMT, reset_reason);

	LOG_INF("App: Reset reason: 0x%x", reset_reason);
	nrfx_reset_reason_clear(reset_reason);

	if (!client) {
		LOG_ERR("Golioth client not initialized!");
		return -EINVAL;
	}

	err = golioth_stream_set_async(client, DEVICE_DATA_ENDP, GOLIOTH_CONTENT_TYPE_JSON, json_buf,
				       strlen(json_buf), async_error_handler, NULL);
	if (err) {
		LOG_ERR("Failed to send device info to Golioth: %d", err);
		return err;
	} else {
		LOG_INF("Sent device info to Golioth");
	}

	return 0;
}
```

## src/app_sensors.h
```c
/*
 * Copyright (c) 2025 Conexio Technologies, Inc
 * Copyright (c) 2022-2023 Golioth, Inc.
 *
 * SPDX-License-Identifier: Apache-2.0
 */

#ifndef __APP_SENSORS_H__
#define __APP_SENSORS_H__

/** The `app_sensors.c` file performs the important work of this application
 * which is to read sensor values and report them to the Golioth LightDB Stream
 * as time-series data.
 *
 * For this demonstration, a `counter` value is periodically logged and pushed
 * to the Golioth time-series database. This simulated sensor reading occurs
 * when the loop in `main.c` calls `app_sensors_read_and_stream()`. The
 * frequency of this loop is determined by values received from the Golioth
 * Settings Service (see app_settings.h).
 *
 * https://docs.golioth.io/firmware/zephyr-device-sdk/light-db-stream/
 */

#include <golioth/client.h>

void app_sensors_set_client(struct golioth_client *sensors_client);
void app_sensors_read_and_stream(void);
int report_startup(void);

#endif /* __APP_SENSORS_H__ */
```

## src/app_settings.c
```c
/*
 * Copyright (c) 2022-2023 Golioth, Inc.
 *
 * SPDX-License-Identifier: Apache-2.0
 */

#include <zephyr/logging/log.h>
LOG_MODULE_REGISTER(app_settings, LOG_LEVEL_DBG);

#include <golioth/client.h>
#include <golioth/settings.h>
#include "main.h"
#include "app_settings.h"

static int32_t _loop_delay_s = CONFIG_SENSOR_SAMPLE_INTERVAL_SECONDS;
#define LOOP_DELAY_S_MAX 43200
#define LOOP_DELAY_S_MIN 1

int32_t get_loop_delay_s(void)
{
	return _loop_delay_s;
}

static enum golioth_settings_status on_loop_delay_setting(int32_t new_value, void *arg)
{
	_loop_delay_s = new_value;
	LOG_INF("Set loop delay to %i seconds", new_value);
	wake_system_thread();
	return GOLIOTH_SETTINGS_SUCCESS;
}

int app_settings_register(struct golioth_client *client)
{
	struct golioth_settings *settings = golioth_settings_init(client);

	int err = golioth_settings_register_int_with_range(settings,
							   "LOOP_DELAY_S",
							   LOOP_DELAY_S_MIN,
							   LOOP_DELAY_S_MAX,
							   on_loop_delay_setting,
							   NULL);

	if (err) {
		LOG_ERR("Failed to register settings callback: %d", err);
	}

	return err;
}
```

## src/cellular_nrf91.c
```c
/*
 * Copyright (c) 2025 Golioth, Inc.
 *
 * SPDX-License-Identifier: Apache-2.0
 */

#include <zephyr/logging/log.h>
LOG_MODULE_REGISTER(cellular_nrf91);

#include <modem/lte_lc.h>

// #include "cellular.h"
#include "location_tracking.h"

/* Indicates when individual ncellmeas operation is completed. This is internal to this file. */
static K_SEM_DEFINE(scan_cellular_sem_ncellmeas_evt, 0, 1);

static enum lte_lc_lte_mode lte_mode;
static struct lte_lc_ncell neighbor_cells[CONFIG_LTE_NEIGHBOR_CELLS_MAX];
static struct lte_lc_cells_info scan_cellular_info = {
    .neighbor_cells = neighbor_cells,
};

static const char *lte_mode_to_str(enum lte_lc_lte_mode mode)
{
    switch (mode)
    {
        case LTE_LC_LTE_MODE_LTEM:
            return "LTEM";
        case LTE_LC_LTE_MODE_NBIOT:
            return "NBIOT";
        case LTE_LC_LTE_MODE_NONE:
            return "NONE";
    }

    return "unknown";
}

static void lte_ind_handler(const struct lte_lc_evt *const evt)
{
    switch (evt->type)
    {
        case LTE_LC_EVT_LTE_MODE_UPDATE:
            LOG_INF("LTE mode: %s", lte_mode_to_str(evt->lte_mode));
            lte_mode = evt->lte_mode;
            break;
        case LTE_LC_EVT_CELL_UPDATE:
            LOG_INF("LTE cell changed: Cell ID: %d, Tracking area: %d",
                    evt->cell.id,
                    evt->cell.tac);
            break;
        case LTE_LC_EVT_NEIGHBOR_CELL_MEAS:
            LOG_INF("LTE current cell: MCC %d, MNC %d, Cell ID: %d, Tracking area: %d",
                    evt->cells_info.current_cell.mcc,
                    evt->cells_info.current_cell.mnc,
                    evt->cells_info.current_cell.id,
                    evt->cells_info.current_cell.tac);

            LOG_INF(
                "Cell measurements results received: "
                "ncells_count=%d, gci_cells_count=%d, current_cell.id=0x%08X",
                evt->cells_info.ncells_count,
                evt->cells_info.gci_cells_count,
                evt->cells_info.current_cell.id);

            if (evt->cells_info.current_cell.id != LTE_LC_CELL_EUTRAN_ID_INVALID)
            {
                /* Copy current cell information. We are seeing this is not set for GCI
                 * search sometimes but we have it for the previous normal neighbor search.
                 */
                memcpy(&scan_cellular_info.current_cell,
                       &evt->cells_info.current_cell,
                       sizeof(struct lte_lc_cell));
            }

            /* Copy neighbor cell information if present */
            if (evt->cells_info.ncells_count > 0 && evt->cells_info.neighbor_cells)
            {
                memcpy(scan_cellular_info.neighbor_cells,
                       evt->cells_info.neighbor_cells,
                       sizeof(struct lte_lc_ncell) * evt->cells_info.ncells_count);

                scan_cellular_info.ncells_count = evt->cells_info.ncells_count;
            }
            else
            {
                LOG_DBG("No neighbor cell information from modem");
            }

            /* Copy surrounding cell information if present */
            if (evt->cells_info.gci_cells_count > 0 && evt->cells_info.gci_cells)
            {
                memcpy(scan_cellular_info.gci_cells,
                       evt->cells_info.gci_cells,
                       sizeof(struct lte_lc_cell) * evt->cells_info.gci_cells_count);

                scan_cellular_info.gci_cells_count = evt->cells_info.gci_cells_count;
            }
            else
            {
                LOG_DBG("No surrounding cell information from modem");
            }

            k_sem_give(&scan_cellular_sem_ncellmeas_evt);
            break;

        default:
            break;
    }
}

int cellular_info_get(struct golioth_cellular_info *infos,
                      size_t num_max_infos,
                      size_t *num_returned_infos)
{
    struct lte_lc_ncellmeas_params params = {
        .search_type = LTE_LC_NEIGHBOR_SEARCH_TYPE_EXTENDED_LIGHT,
    };
    struct lte_lc_cell *current = &scan_cellular_info.current_cell;
    int err;

    err = lte_lc_neighbor_cell_measurement(&params);
    if (err)
    {
        return err;
    }

    err = k_sem_take(&scan_cellular_sem_ncellmeas_evt, K_FOREVER);
    if (err)
    {
        /* Semaphore was reset so stop search procedure */
        err = 0;
    }

    switch (lte_mode)
    {
        case LTE_LC_LTE_MODE_LTEM:
            infos[0].type = GOLIOTH_CELLULAR_TYPE_LTECATM;
            break;
        case LTE_LC_LTE_MODE_NBIOT:
            infos[0].type = GOLIOTH_CELLULAR_TYPE_NBIOT;
            break;
        default:
            *num_returned_infos = 0;
            return 0;
    }

    infos[0].mcc = current->mcc;
    infos[0].mnc = current->mnc;
    infos[0].id = current->id;

    *num_returned_infos = 1;

    return 0;
}

static int cellular_nrf91_init(void)
{
    lte_lc_register_handler(lte_ind_handler);

    return 0;
}

SYS_INIT(cellular_nrf91_init, APPLICATION, CONFIG_APPLICATION_INIT_PRIORITY);
```

## src/fuel_gauge.c
```c
/*
 * Copyright (c) 2025 Conexio Technologies, Inc.
 * Author: Rajeev Piyare <rajeev@conexiotech.com>
 */

#include <stdlib.h>
#include <zephyr/kernel.h>
#include <zephyr/device.h>
#include <zephyr/logging/log.h>
#include <golioth/client.h>
#include <golioth/stream.h>
#include <zcbor_encode.h>
#include <zephyr/drivers/sensor.h>
#include <zephyr/drivers/sensor/npm1300_charger.h>
#include <zephyr/drivers/mfd/npm1300.h>
#include <zephyr/drivers/regulator.h>
#include <zephyr/sys/util.h>
#include "nrf_fuel_gauge.h"
#include "fuel_gauge.h"
#include "app_sensors.h"

#if defined(CONFIG_NRF_FUEL_GAUGE)

LOG_MODULE_REGISTER(battery, LOG_LEVEL_DBG);

static const struct device *pmic = DEVICE_DT_GET(DT_INST(0, nordic_npm1300));
static const struct device *charger = DEVICE_DT_GET(DT_NODELABEL(pmic_charger));
/* For settig up 3V3 regulator */
static const struct device *buck2 = DEVICE_DT_GET(DT_NODELABEL(reg_3v3));

static volatile bool vbus_connected;

#define NPM1300_CHGR_BASE 0x3
#define NPM1300_CHGR_OFFSET_DIS_SET 0x06

/* nPM1300 CHARGER.BCHGCHARGESTATUS.CONSTANTCURRENT register bitmask */
#define NPM1300_CHG_STATUS_CC_MASK BIT_MASK(3)
#define NUM_KEY_VALUE_PAIRS		5

static bool initialized = false;
static float max_charge_current;
static float term_charge_current;
static int64_t ref_time;
static struct battery_data batt_data;

static const struct battery_model battery_model = {
#include "battery_model.inc"
};

static int npm1300_disable_ntc(void)
{
	int ret = 0;

	ret = mfd_npm1300_reg_write(pmic, NPM1300_CHGR_BASE, NPM1300_CHGR_OFFSET_DIS_SET, 2);
	if (ret < 0)
	{
		return ret;
	}

	return ret;
}

static void event_callback(const struct device *dev, struct gpio_callback *cb, uint32_t pins)
{
	vbus_connected = (pins & BIT(NPM1300_EVENT_VBUS_DETECTED)) ? true :
					 (pins & BIT(NPM1300_EVENT_VBUS_REMOVED)) ? false : vbus_connected;
	LOG_DBG("Vbus %s", vbus_connected ? "connected" : "removed");
}

static inline float get_sensor_value(const struct device *dev, enum sensor_channel chan)
{
	struct sensor_value value;
	if (sensor_channel_get(dev, chan, &value) == 0) {
		return sensor_value_to_float(&value);
	}
	return 0.0f;
}

static int fuel_gauge_init_params(const struct device *charger)
{
	struct nrf_fuel_gauge_init_parameters parameters = {
		.model = &battery_model,
		.opt_params = NULL,
	};

	LOG_DBG("nRF Fuel Gauge version: %s", nrf_fuel_gauge_version);

	if (sensor_sample_fetch(charger) < 0) {
		return -EIO;
	}

	parameters.v0 = get_sensor_value(charger, SENSOR_CHAN_GAUGE_VOLTAGE);
	parameters.i0 = get_sensor_value(charger, SENSOR_CHAN_GAUGE_AVG_CURRENT);
	parameters.t0 = get_sensor_value(charger, SENSOR_CHAN_GAUGE_TEMP);
	max_charge_current = get_sensor_value(charger, SENSOR_CHAN_GAUGE_DESIRED_CHARGING_CURRENT);
	term_charge_current = max_charge_current / 10.f;

	nrf_fuel_gauge_init(&parameters, NULL);
	ref_time = k_uptime_get();

	return 0;
}

int fuel_gauge_update(const struct device *charger, bool vbus_connected)
{
	if (sensor_sample_fetch(charger) < 0) {
		LOG_ERR("Error: Could not fetch sensor samples");
		return -EIO;
	}

	batt_data.voltage = get_sensor_value(charger, SENSOR_CHAN_GAUGE_VOLTAGE);
	batt_data.temp = get_sensor_value(charger, SENSOR_CHAN_GAUGE_TEMP);
	batt_data.current = get_sensor_value(charger, SENSOR_CHAN_GAUGE_AVG_CURRENT);

	int32_t chg_status = (int32_t)get_sensor_value(charger, SENSOR_CHAN_NPM1300_CHARGER_STATUS);
	bool cc_charging = (chg_status & NPM1300_CHG_STATUS_CC_MASK) != 0;

	float delta = (float)k_uptime_delta(&ref_time) / 1000.f;
	batt_data.soc = nrf_fuel_gauge_process(batt_data.voltage, batt_data.current, batt_data.temp, delta, vbus_connected, NULL);
	batt_data.tte = nrf_fuel_gauge_tte_get();
	batt_data.ttf = nrf_fuel_gauge_ttf_get(cc_charging, -term_charge_current);

	LOG_DBG("V: %.2f, I: %.2f, SoC: %.2f, TTE: %.0f, TTF: %.0f",
		(double)batt_data.voltage, (double)batt_data.current, (double)batt_data.soc, (double)batt_data.tte, (double)batt_data.ttf);

	return 0;
}

void get_battery_data(struct battery_data *data)
{
	fuel_gauge_update(charger, vbus_connected);
    *data = batt_data;
}

/**@brief Initialize nPM1300 fuel gauge. */
int npm1300_fuel_gauge_init(void)
{
	int err;

	LOG_DBG("Init and start nPM1300 PMIC");

	if (!device_is_ready(pmic) || !device_is_ready(charger)) {
		LOG_ERR("PMIC or Charger device not ready.");
		return -ENODEV;
	}

	npm1300_disable_ntc();

	if (fuel_gauge_init_params(charger) < 0) {
		LOG_ERR("Could not initialise fuel gauge.");
	}

	static struct gpio_callback event_cb;
	gpio_init_callback(&event_cb, event_callback,
				   BIT(NPM1300_EVENT_VBUS_DETECTED) |
				   BIT(NPM1300_EVENT_VBUS_REMOVED));

	err = mfd_npm1300_add_callback(pmic, &event_cb);
	if (err) {
		LOG_ERR("Failed to add pmic callback.");
	}

	/* Initialise vbus detection status. */
	struct sensor_value val;
	int ret = sensor_attr_get(charger, SENSOR_CHAN_CURRENT, SENSOR_ATTR_UPPER_THRESH, &val);

	if (ret < 0) {
		return false;
	}

	vbus_connected = (val.val1 != 0) || (val.val2 != 0);
	initialized = true;
	LOG_DBG("PMIC device init successful\n");

	return initialized;
}

#endif /* CONFIG_NRF_FUEL_GAUGE */
```

## src/fuel_gauge.h
```c
/*
 * Copyright (c) 2025 Conexio Technologies, Inc
 */

#ifndef __FUEL_GAUGE_H__
#define __FUEL_GAUGE_H__

#include <zcbor_encode.h>

struct battery_data {
    float voltage;
    float current;
    float temp;
    float soc;
    float tte;
    float ttf;
};

int npm1300_fuel_gauge_init(void);
void get_battery_data(struct battery_data *data);
int set_3v3_power_gate(bool state);
void turn_off_regulators(void);

#endif /* __FUEL_GAUGE_H__ */
```

## src/location_tracking.c
```c
/*
 * Copyright (c) 2025 Conexio Technologies, Inc
 */

#include <zephyr/kernel.h>
#include <zephyr/logging/log.h>
#include <stdio.h>
#include <string.h>

#include <golioth/client.h>
#include <golioth/location/cellular.h>
#include <string.h>
#include <samples/common/net_connect.h>
#include "location_tracking.h"
#include "main.h"

#if defined(CONFIG_LOCATION_TRACKING)
LOG_MODULE_REGISTER(location_tracking, LOG_LEVEL_DBG);

/* Timer used to time the location sampling rate. */
static K_TIMER_DEFINE(location_sample_timer, NULL, NULL);

#define APP_TIMEOUT_S 10

static struct golioth_location_req location_req;

static int cellular_get_and_encode_info(void)
{
    struct golioth_cellular_info cellular_infos[4];
    enum golioth_status status;
    size_t num_infos;
    int err;

    if (!IS_ENABLED(CONFIG_GOLIOTH_LOCATION_CELLULAR))
    {
        LOG_ERR("!IS_ENABLED(CONFIG_GOLIOTH_LOCATION_CELLULAR)");
        return 0;
    }

    err = cellular_info_get(cellular_infos, ARRAY_SIZE(cellular_infos), &num_infos);
    if (err)
    {
        LOG_ERR("Failed to get cellular network info: %d", err);
        return err;
    }

    for (size_t i = 0; i < num_infos; i++)
    {
        status = golioth_location_cellular_append(&location_req, &cellular_infos[i]);
        if (status != GOLIOTH_OK)
        {
            LOG_ERR("Failed to append cellular info: %d", status);
            return -ENOMEM;
        }
    }

    return 0;
}

void location_tracking_thread_fn(void)
{
    struct golioth_location_rsp location_rsp;
    enum golioth_status status;
    int err;

	LOG_INF("Location tracking module has started");

	/* Begin location tracker */
	while (true) {
		k_timer_start(&location_sample_timer,
			K_SECONDS(CONFIG_LOCATION_TRACKING_SAMPLE_INTERVAL_SECONDS), K_FOREVER);

        golioth_location_init(&location_req);

        err = cellular_get_and_encode_info();
        if (err)
        {
            LOG_ERR("cellular_get_and_encode_info() err");
            continue;
        }

        status = golioth_location_finish(&location_req);
        if (status != GOLIOTH_OK)
        {
            LOG_ERR("Failed golioth_location_finish");
            if (status == GOLIOTH_ERR_NULL)
            {
                LOG_WRN("No location data to be provided");
                return;
            }

            LOG_ERR("Failed to encode location data");
            return;
        }

        status = golioth_location_get_sync(client, &location_req, &location_rsp, APP_TIMEOUT_S);
        if (status == GOLIOTH_OK)
        {
            LOG_INF("%s%lld.%09lld %s%lld.%09lld (%lld)",
                    location_rsp.latitude < 0 ? "-" : "",
                    llabs(location_rsp.latitude) / 1000000000,
                    llabs(location_rsp.latitude) % 1000000000,
                    location_rsp.longitude < 0 ? "-" : "",
                    llabs(location_rsp.longitude) / 1000000000,
                    llabs(location_rsp.longitude) % 1000000000,
                    (long long int) location_rsp.accuracy);
        }

		/* Wait out any remaining time on the sample interval timer. */
		k_timer_status_sync(&location_sample_timer);
	}
}
#endif
```

## src/location_tracking.h
```c
/*
 * Copyright (c) 2025 Conexio Technologies, Inc
 */

#ifndef _LOCATION_TRACKING_H_
#define _LOCATION_TRACKING_H_

#include <golioth/location/cellular.h>

void location_tracking_thread_fn(void);

int cellular_info_get(struct golioth_cellular_info *infos,
                      size_t num_max_infos,
                      size_t *num_returned_infos);

#endif /* _LOCATION_TRACKING_H_ */
```

## src/main.h
```c
/*
 * Copyright (c) 2023 Golioth, Inc.
 *
 * SPDX-License-Identifier: Apache-2.0
 */

extern struct golioth_client *client;

void wake_system_thread(void);
```
